## config/west.yml
```yaml
manifest:
  remotes:
    - name: urob
      url-base: https://github.com/urob
  projects:
    - name: zmk
      remote: urob
      revision: 75334549c1e0876c74d5e1ebf600db5b99a57022
      import: app/west.yml
  self:
    path: config
```
